## boards/arm/dwm3001c_custom/Kconfig.board
```kconfig
# DWM3001C Custom Board configuration

# Copyright (c) 2026
# SPDX-License-Identifier: Apache-2.0

config BOARD_DWM3001C_CUSTOM
	bool "DWM3001C Custom Board"
	depends on SOC_NRF52833_QIAA
```

## boards/arm/dwm3001c_custom/Kconfig.defconfig
```kconfig
# DWM3001C Custom Board configuration

# Copyright (c) 2026
# SPDX-License-Identifier: Apache-2.0

if BOARD_DWM3001C_CUSTOM

config BOARD
	default "dwm3001c_custom"

config BT_CTLR
	default BT

endif # BOARD_DWM3001C_CUSTOM
```

## boards/arm/dwm3001c_custom/dwm3001c_custom_defconfig
```kconfig
# SPDX-License-Identifier: Apache-2.0

CONFIG_SOC_SERIES_NRF52X=y
CONFIG_SOC_NRF52833_QIAA=y
CONFIG_BOARD_DWM3001C_CUSTOM=y

# Enable MPU
CONFIG_ARM_MPU=y

# Enable hardware stack protection
CONFIG_HW_STACK_PROTECTION=y

# Enable GPIO
CONFIG_GPIO=y

# Enable UART driver
CONFIG_SERIAL=y

# Enable console
CONFIG_CONSOLE=y
CONFIG_UART_CONSOLE=y

# IMPORTANT: Do NOT enable APPROTECT — ST-Link V2 cannot recover
# a locked nRF52833. See docs/HARDWARE_TEST.md.
# CONFIG_NRF_APPROTECT_LOCK is intentionally NOT set.
```
